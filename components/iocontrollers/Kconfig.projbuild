## components/iocontrollers/Kconfig.projbuild
```kconfig
menu "INPUT/OUTPUT menu"
    choice RELAY1_SWITCH_MODE
        prompt "Relay1 mode"
        default SWITCH_MODE_SIMPLE
        help
            Mode the flash chip is flashed in, as well as the default mode for the
            binary to run in.

        config RELAY1_SWITCH_MODE_SIMPLE
            bool "ON/OFF"
            select SWITCH_MODE_SIMPLE
        config RELAY1_SWITCH_MODE_TOGGLE
            bool "TOGGLE"
            select SWITCH_MODE_TOGGLE
    endchoice
    config RELAY_1_PIN
        int "Relay1 pin number"
        default "12"
        help
            Relay 1 pin number.
    config RELAY_2_PIN
        int "Relay2 pin number"
        default "13"
        help
            Relay 2 pin number.
    config OPTO_1_PIN
        int "Opto1 pin number"
        default "14"
        help
            Opto 1 pin number.
    config OPTO_2_PIN
        int "Opto2 pin number"
        default "15"
        help
            Opto 1 pin number.
    config SW_1_PIN
        int "SW1 pin number"
        default "35"
        help
            SW 1 pin number.
    config SW_2_PIN
        int "SW2 pin number"
        default "36"
        help
            SW 2 pin number.
    config INPUT_1_PIN
        int "INPUT1 pin number"
        default "2"
        help
            INPUT 1 pin number.
    config INPUT_2_PIN
        int "INPUT2 pin number"
        default "4"
        help
            INPUT 2 pin number.   
endmenu
```

## components/temperature/Kconfig.projbuild
```kconfig
menu "Temperature sensor menu"
    config RESISTANCE_VALUE
        int "R13 measured value (Ohms)"
        default "30000"
        help
            Real measured value of resistor used in circuit. 
    config TEMP_CORRECTION
        int "Temperature correction (tenths of degree celsius)"
        default "0"
        help
            Correction in degrees Celsius. Added within calculation of temeprature.
    config TEMP_SENSOR_ON_PIN
        int "Sensor ON/OFF pin"
        default "33"
        help
            Pin used to turn on/off sensor. 
endmenu
```
